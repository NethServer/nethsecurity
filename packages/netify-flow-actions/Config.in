## packages/netify-flow-actions/Config.in
```kconfig
menu "Configuration"
	depends on PACKAGE_netify-flow-actions

config NETIFY_FLOW_ACTIONS_TARGET_LOG
	bool "Log Target Support"
	default y
	help
		This enables the log target.

config NETIFY_FLOW_ACTIONS_TARGET_CTLABEL
	bool "Conntrack Labels (ctlabel) Target Support"
	default n
	help
		This enables the ctlabel target.

config NETIFY_FLOW_ACTIONS_TARGET_IPSET
	bool "IP Sets Target Support"
	default n
	help
		This enables the IP Sets target.

config NETIFY_FLOW_ACTIONS_TARGET_NFTSET
	bool "nftables Sets Target Support"
	default n
	help
		This enables the nftables Sets target.

endmenu
```

## packages/netify-proc-core/Config.in
```kconfig
menu "Configuration"
	depends on PACKAGE_netify-core

config NETIFY_PROC_CORE_WITH_STDCPP17
	bool "Compile using the C++17 standard?"
	default y
	help
		Compile with the C++17 standard.

endmenu
```

## packages/netify-sink-log/Config.in
```kconfig
menu "Configuration"
	depends on PACKAGE_netify-sink-log

config NETIFY_SINK_LOG_WITH_STDCPP17
	bool "Compile using the C++17 standard?"
	default y
	help
		Compile with the C++17 standard.

endmenu
```

## packages/netify-sink-socket/Config.in
```kconfig
menu "Configuration"
	depends on PACKAGE_netify-sink-socket

config NETIFY_SINK_SOCKET_WITH_STDCPP17
	bool "Compile using the C++17 standard?"
	default y
	help
		Compile with the C++17 standard.

endmenu
```

## packages/netifyd/Config.in
```kconfig
menu "Configuration"
	depends on PACKAGE_netifyd

config NETIFYD_ENABLE_OPENWRT
	bool "Enable OpenWrt support (UCI, UBUS)?"
	default y
	help
		Enable to include UCI and UBUS integration.

config NETIFYD_BUILD_SHARED_LIBRARY
	bool "Build the Agent as a shared library?"
	default y
	help
		Build the Agent as a shared library when enabled, or statically link it otherwise.  Statically linking can make debugging easier.

config NETIFYD_WITH_STDCPP17
	bool "Compile using the C++17 standard?"
	default y
	help
		Compile with the C++17 standard.

config NETIFYD_WITH_LOCAL_LIBGCRYPT
	bool "Link nDPI with the local system libgcrypt?"
	default y
	help
		Link the Agent (and nDPI) against the local system libgcrypt, or use the bundled gcrypt lite version.

config NETIFYD_ENABLE_LEAN_AND_MEAN
	bool "Enable lean-and-mean?"
	default y
	help
		Enable to reduce the size of the application image as much as possible.  For very small embedded systems.

config NETIFYD_ENABLE_LINUX_CAPABILITIES
	bool "Enable support for Linux Capabilities?"
	default n
	help
		Enable Linux Capabilities support in order to run as a non-root user.

config NETIFYD_ENABLE_CONNTRACK_MDATA
	bool "Enable extraction of supplemental conntrack metadata?"
	default y
	help
		Enable the extraction of additional connection tracking metadata such as MARK values.

config NETIFYD_ENABLE_CONNTRACK_COUNTERS
	bool "Enable conntrack accounting counters?"
	default y
	help
		Enable to extract flow packet and byte counters on each update interval.  Often used in combination with NFQUEUE or flow offloading.

config NETIFYD_ENABLE_TPACKETV3
	bool "Enable TPACKETv3 capture support?"
	default n
	help
		Enable to support TPACKETv3 capture support.

config NETIFYD_ENABLE_NFQUEUE
	bool "Enable NFQUEUE capture support?"
	default y
	help
		Enable to support NFQUEUE capture support.

config NETIFYD_ENABLE_EXTENDED_STATS
	bool "Enable the collection of extended flow stats?"
	default y
	help
		Enable to collect additional flow statistics, such as flow rates, TCP sequence errors, and resets.

endmenu
```
